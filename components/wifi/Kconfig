## components/wifi/Kconfig
```kconfig
menu "WiFi Configuration"

    config WIFI_SSID
        string "WiFi SSID"
        default "myssid"
        help
            SSID of the WiFi network to join.

    config WIFI_PASSWORD
        string "WiFi password"
        default "mypassword"
        help
            WiFi password. Networks weaker than WPA2 are rejected unless this
            is left empty, in which case an open network is expected.

    config WIFI_MAX_BACKOFF_MS
        int "Max WiFi reconnect backoff (ms)"
        default 30000
        range 1000 600000
        help
            Upper bound on the delay between reconnect attempts. The delay
            starts at 1s and doubles after each failed attempt up to this
            value. Reconnection is retried indefinitely.

endmenu
```

## main/Kconfig.projbuild
```kconfig
menu "Conveyor Monitor Project Configuration"

    config MQTT_BROKER_URI
        string "MQTT broker URI"
        default "mqtt://raspberrypi.local:1883"
        help
            URI of the MQTT broker to connect to.

            Default assumes a Mosquitto broker running on the Raspberry Pi
            itself (see deploy/mosquitto/), reachable via the mDNS hostname
            Raspberry Pi OS advertises out of the box (avahi-daemon). If mDNS
            doesn't resolve on network (some hotspots/routers block it),
            replace with the Pi's LAN IP instead: mqtt://<pi's LAN IP>:1883


    config MPU6500_SDA_GPIO
        int "MPU6500 I2C SDA GPIO"
        default 21
        help
            GPIO connected to the MPU6500's SDA pin.

    config MPU6500_SCL_GPIO
        int "MPU6500 I2C SCL GPIO"
        default 22
        help
            GPIO connected to the MPU6500's SCL pin.

    config MPU6500_INT_GPIO
        int "MPU6500 INT GPIO"
        default 4
        help
            GPIO connected to the MPU6500's INT pin. The sensor pulses this
            line once per internal sample (DATA_RDY, enabled in
            mpu6500_enable_data_ready_interrupt()); app_main.c attaches a
            GPIO ISR here that wakes sample_task, so sampling is driven by
            the sensor's own hardware interrupt rather than a software
            timer.

    config MPU6500_I2C_FREQ_HZ
        int "MPU6500 I2C bus frequency (Hz)"
        default 400000
        help
            I2C clock speed used to talk to the MPU6500.

    config SAMPLE_RATE_HZ
        int "Accelerometer sample rate (Hz)"
        default 500
        range 4 1000
        help
            The single source of truth for the sample rate. mpu6500_init()
            programs the sensor's SMPLRT_DIV register from it
            (rate = 1kHz / (1 + SMPLRT_DIV) with the DLPF enabled), so it
            must evenly divide 1000: e.g. 1000, 500, 250, 200, 125, 100.
            Other values fail the build. Sampling is driven by the sensor's
            own DATA_RDY interrupt at this rate, and the value is sent as
            the JSON payload's sample_rate_hz field, which the backend uses
            for the FFT frequency axis. Keep it above twice the highest
            mechanical frequency of interest (Nyquist); note the accel DLPF
            cuts off at ~184Hz regardless.

    config SAMPLE_WINDOW_SIZE
        int "Samples per published window"
        default 256
        help
            Number of samples buffered per axis before publishing one MQTT
            window as JSON. A power of two is recommended because
            most FFT implementations are radix-2 and prefer it.

endmenu
```
